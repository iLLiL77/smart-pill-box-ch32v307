#include "oled.h"

#define OLED_ADDR  0x78
#define I2C_DELAY  Delay_Us(5)

/* ---- 当前选中的 OLED (0=OLED1, 1=OLED2) ---- */
static uint8_t oled_sel = 0;

/* 根据 oled_sel 获取当前端口和引脚 */
static GPIO_TypeDef* oled_port(void) { return (oled_sel == 0) ? OLED_PORT : OLED2_PORT; }
static uint16_t       oled_sda(void) { return (oled_sel == 0) ? OLED_SDA  : OLED2_SDA; }
static uint16_t       oled_scl(void) { return (oled_sel == 0) ? OLED_SCL  : OLED2_SCL; }

void OLED_Select(uint8_t id)
{
    oled_sel = (id != 0) ? 1 : 0;
}

/* ---- 6x8 字体 ---- */
const uint8_t font_6x8[][6] = {
    {0x00,0x00,0x00,0x00,0x00,0x00}, /*   0x20 */
    {0x00,0x00,0x00,0x4F,0x00,0x00}, /* ! */
    {0x00,0x00,0x07,0x00,0x07,0x00}, /* " */
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    {0x00,0x08,0x04,0x08,0x10,0x08}, /* ~ */
};

/*==========================================================================
 * I2C (根据 oled_sel 自动切换端口)
 *==========================================================================*/
#define I2C_SDA_H()  GPIO_SetBits(oled_port(), oled_sda())
#define I2C_SDA_L()  GPIO_ResetBits(oled_port(), oled_sda())
#define I2C_SCL_H()  GPIO_SetBits(oled_port(), oled_scl())
#define I2C_SCL_L()  GPIO_ResetBits(oled_port(), oled_scl())

static void I2C_Start(void)
{ I2C_SDA_H(); I2C_SCL_H(); I2C_DELAY; I2C_SDA_L(); I2C_DELAY; I2C_SCL_L(); }
static void I2C_Stop(void)
{ I2C_SDA_L(); I2C_SCL_H(); I2C_DELAY; I2C_SDA_H(); I2C_DELAY; }

static void I2C_SendByte(uint8_t dat)
{
    uint8_t i;
    for(i=0;i<8;i++)
    { if(dat&0x80) I2C_SDA_H(); else I2C_SDA_L(); dat<<=1; I2C_DELAY; I2C_SCL_H(); I2C_DELAY; I2C_SCL_L(); }
    I2C_SDA_H(); I2C_DELAY; I2C_SCL_H(); I2C_DELAY; I2C_SCL_L();
}

static void OLED_Cmd(uint8_t cmd)
{ I2C_Start(); I2C_SendByte(OLED_ADDR); I2C_SendByte(0x00); I2C_SendByte(cmd); I2C_Stop(); }
static void OLED_Data(uint8_t dat)
{ I2C_Start(); I2C_SendByte(OLED_ADDR); I2C_SendByte(0x40); I2C_SendByte(dat); I2C_Stop(); }

/*==========================================================================
 * 基础显示
 *==========================================================================*/
void OLED_Clear(void)
{
    uint8_t y,x;
    for(y=0;y<8;y++){ OLED_Cmd(0xB0+y); OLED_Cmd(0x00); OLED_Cmd(0x10); for(x=0;x<128;x++) OLED_Data(0x00); }
}

void OLED_Show_Char(uint8_t x, uint8_t y, uint8_t ch)
{
    uint8_t i;
    if(ch<0x20||ch>0x7E) ch=0x20;
    ch-=0x20;
    OLED_Cmd(0xB0+y); OLED_Cmd(x&0x0F); OLED_Cmd(((x>>4)&0x0F)|0x10);
    for(i=0;i<6;i++) OLED_Data(font_6x8[ch][i]);
}

void OLED_Show_Str(uint8_t x,uint8_t y,const char *str)
{ while(*str){ OLED_Show_Char(x,y,(uint8_t)*str); x+=6; if(x>=126){x=0;y++;} str++; } }

void OLED_Show_Num(uint8_t x,uint8_t y,uint8_t num,uint8_t digits)
{
    uint8_t buf[3], i;
    if(digits > 3) digits = 3;

    buf[2] = num % 10; num /= 10;
    buf[1] = num % 10; num /= 10;
    buf[0] = num % 10;

    for(i = 3 - digits; i < 3; i++)
    {
        OLED_Show_Char(x, y, '0' + buf[i]);
        x += 6;
    }
}

void OLED_Show_Time(uint8_t x,uint8_t y,uint8_t h,uint8_t m)
{
    OLED_Show_Char(x,y,'0'+h/10); OLED_Show_Char(x+6,y,'0'+h%10);
    OLED_Show_Char(x+12,y,':');
    OLED_Show_Char(x+18,y,'0'+m/10); OLED_Show_Char(x+24,y,'0'+m%10);
}

void OLED_Init(void)
{
    Delay_ms(200);
    OLED_Cmd(0xAE); OLED_Cmd(0xD5); OLED_Cmd(0x80); OLED_Cmd(0xA8); OLED_Cmd(0x3F);
    OLED_Cmd(0xD3); OLED_Cmd(0x00); OLED_Cmd(0x40);
    OLED_Cmd(0x8D); OLED_Cmd(0x14); OLED_Cmd(0x20); OLED_Cmd(0x02);
    OLED_Cmd(0xA1); OLED_Cmd(0xC8); OLED_Cmd(0xDA); OLED_Cmd(0x12);
    OLED_Cmd(0x81); OLED_Cmd(0xCF); OLED_Cmd(0xD9); OLED_Cmd(0xF1);
    OLED_Cmd(0xDB); OLED_Cmd(0x40); OLED_Cmd(0xA4); OLED_Cmd(0xA6); OLED_Cmd(0xAF);
    OLED_Clear();
}

/*==========================================================================
 * 显示浮点数
 *==========================================================================*/
void OLED_Show_Float(uint8_t x, uint8_t y, float val, uint8_t int_digits, uint8_t dec_digits)
{
    uint32_t int_part, dec_part, div = 1;
    uint8_t i;

    if(val < 0) { OLED_Show_Char(x, y, '-'); x += 6; val = -val; }
    if(val > 99999.0f) val = 99999.0f;

    int_part = (uint32_t)val;
    for(i = 0; i < dec_digits; i++) div *= 10;
    dec_part = (uint32_t)((val - (float)int_part) * (float)div + 0.5f);
    if(dec_part >= div) { int_part++; dec_part = 0; }

    OLED_Show_Num(x, y, int_part, int_digits);
    x += int_digits * 6;

    if(dec_digits > 0)
    {
        OLED_Show_Char(x, y, '.');
        x += 6;
        for(i = 0; i < dec_digits; i++)
        {
            uint8_t d = dec_part / (div / 10);
            OLED_Show_Char(x, y, '0' + d);
            x += 6;
            dec_part -= d * (div / 10);
            div /= 10;
        }
    }
}

/*==========================================================================
 * 显示重量 (带单位 g)
 *==========================================================================*/
void OLED_Show_Weight(uint8_t x, uint8_t y, float w)
{
    uint8_t chars = 0;
    if(w < 0) w = 0;

    if(w < 10.0f)       { OLED_Show_Float(x, y, w, 1, 1); chars = 3; }
    else if(w < 100.0f) { OLED_Show_Float(x, y, w, 2, 1); chars = 4; }
    else if(w < 1000.0f){ OLED_Show_Float(x, y, w, 3, 1); chars = 5; }
    else                { OLED_Show_Float(x, y, w, 4, 1); chars = 6; }

    OLED_Show_Char(x + chars * 6, y, 'g');
}

/*==========================================================================
 * 显示进度条 (0~100%)
 *==========================================================================*/
void OLED_Show_Bar(uint8_t x, uint8_t y, uint8_t percent)
{
    uint8_t i, blocks;
    if(percent > 100) percent = 100;
    blocks = (uint8_t)((uint16_t)percent * 10 / 100);  /* 0~10 格 */

    OLED_Show_Char(x, y, '[');
    x += 6;
    for(i = 0; i < 10; i++)
    {
        if(i < blocks)
            OLED_Show_Char(x, y, '|');
        else
            OLED_Show_Char(x, y, ' ');
        x += 6;
    }
    OLED_Show_Char(x, y, ']');
}

/*==========================================================================
 * 占位
 *==========================================================================*/
void Refresh_Setup(void) {}
void Refresh_Run(void)   {}
